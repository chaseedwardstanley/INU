# file: VoltageSync.ioc
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Mcu.Family=STM32WB
Mcu.Name=STM32WB55RGVx
Mcu.Package=VFQFPN68
NVIC.HSEM_IRQn=true\:0\:0\:false\:false\:true\:false\:true\:true
NVIC.IPCC_C1_RX_IRQn=true\:0\:0\:false\:false\:true\:true\:true\:true
NVIC.IPCC_C1_TX_IRQn=true\:0\:0\:false\:false\:true\:true\:true\:true
NVIC.PriorityGroup=NVIC_PRIORITYGROUP_4
NVIC.TIM2_IRQn=true\:0\:0\:false\:false\:true\:true\:true\:true
OSC_IN.GPIO_Label=RCC_OSC_IN
OSC_IN.Mode=HSE-External-Oscillator
OSC_IN.Signal=RCC_OSC_IN
OSC_OUT.GPIO_Label=RCC_OSC_OUT
OSC_OUT.Mode=HSE-External-Oscillator
OSC_OUT.Signal=RCC_OSC_OUT
PA11.GPIO_Label=USB_DM
PA11.Signal=USB_DM
PA12.GPIO_Label=USB_DP
PA12.Signal=USB_DP
PA13.GPIO_Label=JTMS
PA13.Signal=SYS_JTMS-SWDIO
PA14.GPIO_Label=JTCK
PA14.Signal=SYS_JTCK-SWCLK
PB3.GPIO_Label=JTDO
PB3.Signal=SYS_JTDO-SWO
PB6.GPIO_Label=STLINK_RX
PB6.Signal=USART1_TX
PB7.GPIO_Label=STLINK_TX
PB7.Signal=USART1_RX
PC13.GPIO_Label=SYS_WKUP2
PC13.Signal=SYS_WKUP2
PC14-OSC32_IN.GPIO_Label=RCC_OSC32_IN
PC14-OSC32_IN.Mode=LSE-External-Oscillator
PC14-OSC32_IN.Signal=RCC_OSC32_IN
PC15-OSC32_OUT.GPIO_Label=RCC_OSC32_OUT
PC15-OSC32_OUT.Mode=LSE-External-Oscillator
PC15-OSC32_OUT.Signal=RCC_OSC32_OUT
ProjectManager.HeapSize=0x200
ProjectManager.StackSize=0x400
ProjectManager.TargetToolchain=CMake
RCC.ADCFreq_Value=128000000
RCC.AHBFreq_Value=32000000
RCC.APB1Freq_Value=32000000
RCC.APB1TimFreq_Value=32000000
RCC.APB2Freq_Value=32000000
RCC.APB2TimFreq_Value=32000000
RCC.APB3Freq_Value=16000000
RCC.CortexFreq_Value=32000000
RCC.HCLKFreq_Value=32000000
RCC.HSE_VALUE=32000000
RCC.HSI48_VALUE=48000000
RCC.HSI_VALUE=16000000
RCC.MSIClockRange=RCC_MSIRANGE_10
RCC.SMPSCLockSelection=RCC_SMPSCLKSOURCE_HSI
RCC.SMPSCLockSelectionVirtual=RCC_SMPSCLKSOURCE_HSI
RCC.SMPSCLockSelectionVirtualVirtual=RCC_SMPSCLKSOURCE_HSI
RCC.SMPSDivider=1
RCC.SYSCLKFreq_VALUE=32000000
RCC.USBFreq_Value=128000000
RCC.VCOOutputFreq_Value=256000000
RF1.Mode=RF1_Activate
RF1.Signal=RF_RF1
STM32_WPAN.BLE_APPLICATION_TYPE=BLE_SERVER_PROFILE
STM32_WPAN.LOCAL_NAME=Voltage
STM32_WPAN.LOCAL_NAME_FORMATTED=,'V','o','l','t','a','g','e'
TIM2.Channel-Output\ Compare1\ No\ Output=TIM_CHANNEL_1
TIM2.Prescaler=31
VP_HSEM_VS_HSEM.Mode=HSEM_Activate
VP_IPCC_VS_IPCC.Mode=IPCC_Activate
VP_MEMORYMAP_VS_MEMORYMAP.Mode=CurAppReg
VP_RTC_VS_RTC_Activate.Mode=RTC_Enabled
VP_SEQUENCER_VS_SEQUENCER.Mode=SEQUENCER_Enabled
VP_STM32_WPAN_VS_BLE_HOST.Mode=STM32_WPAN_Enabled
VP_TIM2_VS_ClockSourceINT.Mode=Internal
VP_TIM2_VS_no_output1.Mode=Output Compare1 No Output
VP_TINY_LPM_VS_TINY_LPM.Mode=TINY_LPM_Enabled
board=NUCLEO-WB55RG

// file: Core/Src/main.c
/* USER CODE BEGIN Header */
/**
  ******************************************************************************
  * @file           : main.c
  * @brief          : Main program body
  ******************************************************************************
  * @attention
  *
  * Copyright (c) 2026 STMicroelectronics.
  * All rights reserved.
  *
  * This software is licensed under terms that can be found in the LICENSE file
  * in the root directory of this software component.
  * If no LICENSE file comes with this software, it is provided AS-IS.
  *
  ******************************************************************************
  */
/* USER CODE END Header */

#include "main.h"
#include "ipcc.h"
#include "rf.h"
#include "rtc.h"
#include "tim.h"
#include "gpio.h"
#include "app_conf.h"
#include "stm32_seq.h"

/* USER CODE BEGIN PV */

/* Incremented every time TIM2 Channel 1 fires. */
volatile uint32_t tim2CompareCount = 0U;

/* USER CODE END PV */

void SystemClock_Config(void);
void PeriphCommonClock_Config(void);

int main(void)
{

  /* MCU Configuration--------------------------------------------------------*/

  HAL_Init();

  /* Config code for STM32_WPAN */
  MX_APPE_Config();

  SystemClock_Config();
  PeriphCommonClock_Config();

  MX_IPCC_Init();

  /* Initialize all configured peripherals */
  MX_GPIO_Init();
  MX_RTC_Init();
  MX_TIM2_Init();
  MX_RF_Init();

  /* USER CODE BEGIN 2 */

  /*
   * Start TIM2 as a free-running 32-bit microsecond timer.
   *
   * TIM2 clock: 32 MHz
   * Prescaler: 31
   * Counter frequency: 1 MHz
   * Resolution: 1 microsecond
   */
  if (HAL_TIM_Base_Start(&htim2) != HAL_OK)
  {
      Error_Handler();
  }

  /* Initialize TIM2 Channel 1 output compare without interrupts. */
if (HAL_TIM_OC_Start(&htim2, TIM_CHANNEL_1) != HAL_OK)
{
    Error_Handler();
}

/* No playback deadline is scheduled yet. */
__HAL_TIM_DISABLE_IT(&htim2, TIM_IT_CC1);
__HAL_TIM_CLEAR_FLAG(&htim2, TIM_FLAG_CC1);

  /*
   * Schedule the first Channel 1 compare event
   * one second after the current counter value.
   */

  /*
   * Enable TIM2 Channel 1 output-compare interrupts.
   * No physical output pin is required.
   */

  /* USER CODE END 2 */

  /* Init code for STM32_WPAN */
  MX_APPE_Init();

  /* Infinite loop */
  while (1)
  {

    MX_APPE_Process();

  }

  /* USER CODE END 3 */
}

void SystemClock_Config(void)
{
  RCC_OscInitTypeDef RCC_OscInitStruct = {0};
  RCC_ClkInitTypeDef RCC_ClkInitStruct = {0};

  /** Configure the main internal regulator output voltage
  */
  __HAL_PWR_VOLTAGESCALING_CONFIG(PWR_REGULATOR_VOLTAGE_SCALE1);

  /** Initializes the RCC Oscillators according to the specified parameters.
  */
  RCC_OscInitStruct.OscillatorType = RCC_OSCILLATORTYPE_HSI|
                                   RCC_OSCILLATORTYPE_LSI1|
                                   RCC_OSCILLATORTYPE_HSE|
                                   RCC_OSCILLATORTYPE_MSI;

  RCC_OscInitStruct.HSEState = RCC_HSE_ON;
  RCC_OscInitStruct.HSIState = RCC_HSI_ON;
  RCC_OscInitStruct.MSIState = RCC_MSI_ON;
  RCC_OscInitStruct.HSICalibrationValue = RCC_HSICALIBRATION_DEFAULT;
  RCC_OscInitStruct.MSIClockRange = RCC_MSIRANGE_10;
  RCC_OscInitStruct.LSIState = RCC_LSI_ON;
  RCC_OscInitStruct.PLL.PLLState = RCC_PLL_NONE;

  if (HAL_RCC_OscConfig(&RCC_OscInitStruct) != HAL_OK)
  {
    Error_Handler();
  }

  /** Configure the SYSCLKSource, HCLK, PCLK1 and PCLK2 clock dividers.
  */
  RCC_ClkInitStruct.ClockType = RCC_CLOCKTYPE_HCLK4|
                                RCC_CLOCKTYPE_HCLK2|
                                RCC_CLOCKTYPE_HCLK|
                                RCC_CLOCKTYPE_SYSCLK|
                                RCC_CLOCKTYPE_PCLK1|
                                RCC_CLOCKTYPE_PCLK2;

  RCC_ClkInitStruct.SYSCLKSource = RCC_SYSCLKSOURCE_MSI;
  RCC_ClkInitStruct.AHBCLKDivider = RCC_SYSCLK_DIV1;
  RCC_ClkInitStruct.APB1CLKDivider = RCC_HCLK_DIV1;
  RCC_ClkInitStruct.APB2CLKDivider = RCC_HCLK_DIV1;
  RCC_ClkInitStruct.AHBCLK2Divider = RCC_SYSCLK_DIV1;
  RCC_ClkInitStruct.AHBCLK4Divider = RCC_SYSCLK_DIV1;

  if (HAL_RCC_ClockConfig(&RCC_ClkInitStruct, FLASH_LATENCY_1) != HAL_OK)
  {
    Error_Handler();
  }
}

void PeriphCommonClock_Config(void)
{
  RCC_PeriphCLKInitTypeDef PeriphClkInitStruct = {0};

  /** Initializes the peripherals clock.
  */
  PeriphClkInitStruct.PeriphClockSelection =
      RCC_PERIPHCLK_SMPS | RCC_PERIPHCLK_RFWAKEUP;

  PeriphClkInitStruct.RFWakeUpClockSelection =
      RCC_RFWKPCLKSOURCE_HSE_DIV1024;

  PeriphClkInitStruct.SmpsClockSelection =
      RCC_SMPSCLKSOURCE_HSI;

  PeriphClkInitStruct.SmpsDivSelection =
      RCC_SMPSCLKDIV_RANGE0;

  if (HAL_RCCEx_PeriphCLKConfig(&PeriphClkInitStruct) != HAL_OK)
  {
    Error_Handler();
  }

}

/* USER CODE BEGIN 4 */

/**
  * @brief TIM2 output-compare callback.
  *
  * Called when TIM2 CNT matches CCR1.
  *
  * For this initial validation, schedule an interrupt
  * every 1,000,000 timer ticks (one second).
  */
void HAL_TIM_OC_DelayElapsedCallback(TIM_HandleTypeDef *htim)
{
    if ((htim->Instance == TIM2) &&
        (htim->Channel == HAL_TIM_ACTIVE_CHANNEL_1))
    {
        tim2CompareCount++;

        __HAL_TIM_DISABLE_IT(htim, TIM_IT_CC1);

        UTIL_SEQ_SetTask(
            1UL << CFG_TASK_VSP_PLAYBACK_ID,
            CFG_SCH_PRIO_0
        );
    }
}

/* USER CODE END 4 */

void Error_Handler(void)
{
  __disable_irq();
  while (1)
  {
  }
}
